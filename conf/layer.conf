## conf/layer.conf
```bitbake
# We have a conf and classes directory, add to BBPATH
BBPATH .= ":${LAYERDIR}"

# We have recipes-* directories, add to BBFILES
BBFILES += "\
    ${LAYERDIR}/recipes-*/*.bb \
    ${LAYERDIR}/recipes-*/*/*.bb \
    ${LAYERDIR}/recipes-*/*.bbappend \
    ${LAYERDIR}/recipes-*/*/*.bbappend"

BBFILE_COLLECTIONS += "nano-editor"
BBFILE_PATTERN_nano-editor = "^${LAYERDIR}/"
BBFILE_PRIORITY_nano-editor = "6"

LAYERDEPENDS_nano-editor = "core"
LAYERSERIES_COMPAT_nano-editor = "kirkstone"
LAYERSERIES_COMPAT_nano-editor = "${LAYERSERIES_COMPAT_core}"
```
